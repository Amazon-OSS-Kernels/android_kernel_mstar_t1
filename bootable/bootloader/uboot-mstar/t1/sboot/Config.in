## kernel/mstar/t1/3.10/drivers/mstar2/drv/dvfs/Kconfig
```kconfig
config MSTAR_DVFS
bool "Mstar Dynamic Voltage and Frequency Scaling"
depends on CPU_FREQ
default n

---help---
    To enable or to disable Mstar dynamic voltage and frequency scaling mechanism

config MSTAR_DVFS_FIXED_CPU_CLOCK
bool "Enable Fixed CPU Clock Mechanism"
depends on MSTAR_DVFS
default n

---help---
    To enable or to disable fixed CPU clock mechanism
	
config MSTAR_DVFS_KERNEL_IIC
bool "DVFS using kernel mode IIC"
depends on MSTAR_DVFS
default n

---help---
    Select if DVFS using kernel mode IIC
```

## kernel/mstar/t1/3.10/drivers/mstar2/drv/gpio/Kconfig
```kconfig
config MSTAR_GPIO

tristate "GPIO"
depends on GPIOLIB
help
    MStar GPIO driver function
```

## kernel/mstar/t1/3.10/drivers/mstar2/drv/iic/Kconfig
```kconfig
config MSTAR_IIC

tristate "SWIIC"
select MSTAR_GPIO
help
    MStar IIC driver function
```

## kernel/mstar/t1/3.10/drivers/mstar2/drv/ipa_pool/Kconfig
```kconfig
config MSTAR_IPAPOOL
bool  "IPA POOL"
depends on CMA
select MSTAR_MIU
default n

help
    MStar IPA POOL driver function

config MSTAR_IPAPOOL_DELAY_FREE
bool  "IPA POOL Delay Free"
depends on MSTAR_IPAPOOL 
default y

help
    Ipa pool delay free
```

## kernel/mstar/t1/3.10/drivers/mstar2/drv/mbx/Kconfig
```kconfig
config MSTAR_MBX
tristate "MBX"
default y
help
    enable MStar MBX driver.

config MSTAR_MBX_U2K
tristate "MBX_U2K"
default n
help
    enable MStar MBX driver for Utopia2K

config MSTAR_MBX_GROUP_PATH
tristate "MBX_GROUP"
default n
help
    enable MStar MBX group patch
```

## kernel/mstar/t1/3.10/drivers/mstar2/drv/ram_console/Kconfig
```kconfig
config MSTAR_RAM_CONSOLE
	bool "Pstore based ram console"
	depends on PSTORE_CONSOLE && PSTORE_RAM
	help
		Enable the ram console support with pstore.
```

## kernel/mstar/t1/3.10/drivers/mstar2/drv/rtc/Kconfig
```kconfig
config MSTAR_RTC

tristate "RTC"
#depends on WATCHDOG
default y
help
    MStar Watchdog driver function
```

## kernel/mstar/t1/3.10/drivers/mstar2/drv/utopia2k_str/Kconfig
```kconfig
config MSTAR_UTOPIA2K_STR

tristate "UTOPIA2K_STR"
depends on MP_MSTAR_STR_BASE
default n
select SYS_SUPPORTS_APM_EMULATION
select APM_EMULATION
help
    MStar Utopia2K STR driver function
    Call all utopia modules' suspend/resume here
    Report wake up event to Android

config SYS_SUPPORTS_APM_EMULATION
    bool
```

## kernel/mstar/t1/3.10/drivers/mstar2/gpu/Kconfig
```kconfig
menu "GPU"

choice
    prompt "Platform"
    default MALI_PROJECT_PLATFORM_NONE
config MALI_PROJECT_PLATFORM_NONE
    bool "None"
#config MALI_PROJECT_PLATFORM_SUPERNOVA
#    bool "Supernova"
#    depends on MSTAR_XXX
config MALI_PROJECT_PLATFORM_ANDROID_LOLLIPOPMR1_64
    bool "Android Lollipop MR1 (64-bit)"
    depends on MSTAR_MASERATI
    depends on SYNC
config MALI_PROJECT_PLATFORM_ANDROID_NOUGAT_64
    bool "Android Nougat (64-bit)"
    depends on MSTAR_MAXIM
    depends on SYNC
endchoice

choice
    prompt "GPU Architecture"
    depends on !MALI_PROJECT_PLATFORM_NONE
    #default GPU_ARCH_MALI_UTGARD if MSTAR_XXX
    default GPU_ARCH_MALI_MIDGARD if MSTAR_MASERATI
    default GPU_ARCH_MALI_MIDGARD if MSTAR_MAXIM
    default GPU_ARCH_NONE
config GPU_ARCH_NONE
    bool "None"
    depends on MALI_PROJECT_PLATFORM_NONE
#config GPU_ARCH_MALI_UTGARD
#    bool "Mali Utgard"
#    depends on MSTAR_XXX
config GPU_ARCH_MALI_MIDGARD
    bool "Mali Midgard"
    depends on MSTAR_MASERATI
config GPU_ARCH_MALI_MIDGARD
    bool "Mali Midgard"
    depends on MSTAR_MAXIM
endchoice

choice
    prompt "Driver Version"
    depends on !MALI_PROJECT_PLATFORM_NONE
    #default MALI_UTGARD_RxPy_00REL0 if MSTAR_XXX
    default MALI_MIDGARD_R10P0_00REL0 if MSTAR_MASERATI
    default MALI_MIDGARD_R14P0_01REL0 if MSTAR_MAXIM
#config MALI_UTGARD_RxPy_00REL0
#    bool "Mali Utgard rxpy-00rel0"
#    depends on MSTAR_XXX
config MALI_MIDGARD_R10P0_00REL0
    bool "Mali Midgard r10p0-00rel0"
    depends on MSTAR_MASERATI
config MALI_MIDGARD_R14P0_01REL0
    bool "Mali Midgard r14p0-01rel0"
    depends on MSTAR_MAXIM
endchoice

config MALI_DRIVER_VERSION
    string
    default "rxpy-00rel0" if MALI_UTGARD_RxPy_00REL0
    default "r10p0-00rel0" if MALI_MIDGARD_R10P0_00REL0
    default "r14p0-01rel0" if MALI_MIDGARD_R14P0_01REL0
    default "error"

config MALI_PROJECT_PLATFORM
    string
    #default "supernova" if MALI_PROJECT_PLATFORM_SUPERNOVA
    default "android-lmr1-64" if MALI_PROJECT_PLATFORM_ANDROID_LOLLIPOPMR1_64
    default "android-nougat-64" if MALI_PROJECT_PLATFORM_ANDROID_NOUGAT_64
    default "error"

config MALI_VERSION_PATH
    string
    option env="MALI_VERSION_PATH"
source "drivers/mstar2/gpu/mali-midgard/$MALI_VERSION_PATH/drivers/gpu/arm/Kconfig"
source "drivers/mstar2/gpu/mali-midgard/$MALI_VERSION_PATH/drivers/base/kds/Kconfig"
source "drivers/mstar2/gpu/mali-midgard/$MALI_VERSION_PATH/drivers/base/ump/Kconfig"

endmenu
```

## kernel/mstar/t1/3.10/drivers/staging/amazon/Kconfig
```kconfig
menu "Amazon"

config AMAZON
	bool "Amazon Drivers"

	default N
	---help---
	  Enable support for various drivers needed on the Amazon Fire OS platform

if AMAZON

config AMAZON_KLOG_CONSOLE
	bool "Amazon Kernel Log Console"
	depends on ANDROID_LOGGER
	default N
	---help---
	  provide the kernel log console which will rewrite the kernel message to Android Logger buffer.

config AMAZON_SIGN_OF_LIFE
	bool "Amazon Sign of Life"
	default N
	---help---
          enable the life cycle metrics to log device boot and shutdown
          information. this is a generic driver and can be ported to
          other devices.  the real implementation will be done in another
          file.

config AMAZON_SIGN_OF_LIFE_MSTAR
	bool "Amazon Sign of Life MStar platform implementation"
	default N
	---help---
          enable the life cycle metrics to log device boot and shutdown information on MStar Platform.

config AMAZON_PLATFORM_BT_RFKILL
	bool "Amazon Platform BT rfkill"
	depends on BRCM_BT
	default y
	---help---
          provide bluetooth rfkill platform driver.

config AMAZON_DISBALE_LOGD_AUDIT_LOG
	bool "Avoid selinux log flooding in console"
	default n


config AMAZON_METRICS_LOG
	bool "Amazon Metrics logger driver"
	select RING_BUFFER
	default n
	---help---
		Enable Amazon Metrics/Vitals logger driver

config AMAZON_MINERVA_METRICS_LOG
	bool "Amazon Minerva Metrics logger"
	select RING_BUFFER
	default n
	---help---
	  Enable Amazon Minerva Metrics and sent metrics
	  through logger to vitals buffer. Both AMAZON_METRICS_LOG and
	  and AMAZON_MINERVA_METRICS_LOG can be defined but only MINERVA
 	  metrics are support in the future.

config AMAZON_METRICS_LOG_TEST
	tristate "Amazon Metrics logger driver test module"
	depends on AMAZON_METRICS_LOG
	default n
	---help---
		Enable Amazon Metrics/Vitals logger test module

config AMAZON_SILENT_OTA_BACKLIGHT
	bool "Amazon silent ota backlight control"
	default n
	---help---
		Enable Amazon silent ota backlight control


endif # if AMAZON

endmenu
```

## kernel/mstar/t1/3.10/drivers/tee/optee/Kconfig
```kconfig
# OP-TEE Trusted Execution Environment Configuration
config OPTEE
	bool "OP-TEE"
	default y
	#depends on HAVE_ARM_SMCCC
	help
	  This implements the OP-TEE Trusted Execution Environment (TEE)
	  driver.
```
